## Kconfig
```kconfig
config QUIET_DONGLE_BATTERY
    bool "Don't announce the central's own battery level to computers"
    depends on BT_BAS && ZMK_BATTERY_REPORTING
    help
      For a dongle without a battery: its Bluetooth battery level stays
      fixed instead of being updated, so it never sends battery
      notifications. Those go to every connected computer, including ones on
      other profiles, and can wake one that's asleep. The keyboard halves'
      battery levels are unaffected.

config STRICT_OUTPUT
    bool "Send keys only to the selected output, never fall back to the other"
    default y
    depends on ZMK_USB && ZMK_BLE && (!ZMK_SPLIT || ZMK_SPLIT_ROLE_CENTRAL)
    help
      Stock ZMK sends to USB when Bluetooth is selected but its host isn't
      connected (and the other way round), which can type into the wrong
      computer or wake a sleeping one. With this on, reports for the
      unselected output are dropped until the selected one reconnects.

config PROSPECTOR_ANTI_IDLE_INDICATOR
    bool "Show anti-idle (jiggler) state on the Prospector display"
    default y
    depends on SHIELD_PROSPECTOR_ADAPTER && ZMK_ANTI_IDLE && ZMK_DISPLAY

config PROSPECTOR_OUTPUT_INDICATOR
    bool "Show the active output (USB or Bluetooth profile) on the Prospector display"
    default y
    depends on SHIELD_PROSPECTOR_ADAPTER && ZMK_DISPLAY

config PROSPECTOR_CLOCK
    bool "24-hour clock on the Prospector display, set by the computer over Raw HID"
    default y
    depends on SHIELD_PROSPECTOR_ADAPTER && ZMK_DISPLAY && RAW_HID
    help
      Shows HH:MM above the active layer name. The time comes from a companion
      app on the computer (qmk-hid-host, or scripts/hid-clock.py on Linux) via
      the zmk-raw-hid module; without one the clock stays hidden.

config PROSPECTOR_CLOCK_12H
    bool "12-hour clock (h:MM AM/PM) instead of 24-hour HH:MM"
    depends on PROSPECTOR_CLOCK

config PROSPECTOR_CLOCK_TIMEOUT_S
    int "Hide the clock after this many seconds without a time update"
    default 180
    range 70 3600
    depends on PROSPECTOR_CLOCK
    help
      The computer sends the time whenever the minute changes, so anything
      over 60 s tolerates a missed update.

config NICE_VIEW_SNOW
    bool "Snowfall animation in place of the nice!view peripheral art"
    default y
    depends on SHIELD_NICE_VIEW && NICE_VIEW_WIDGET_STATUS && ZMK_SPLIT && !ZMK_SPLIT_ROLE_CENTRAL

config NICE_VIEW_SNOW_STATUS
    bool "CaskaydiaCove battery and connection icons on the nice!view"
    help
      Draws battery and connection icons over the top 20 rows of the snow
      scene. Off by default: the Prospector dongle already shows both.
    depends on NICE_VIEW_SNOW

choice NICE_VIEW_SNOW_SCENE
    prompt "Scene the snow falls on"
    depends on NICE_VIEW_SNOW
    default NICE_VIEW_SNOW_SCENE_BALLOON if SHIELD_CORNE_RIGHT
    default NICE_VIEW_SNOW_SCENE_MOUNTAIN

config NICE_VIEW_SNOW_SCENE_MOUNTAIN
    bool "Stock mountain (dark mountain, dithered sun rays and pines)"

config NICE_VIEW_SNOW_SCENE_MOUNTAIN_NIGHT
    bool "Mountain at night (stars, crescent moon, white ridge)"

config NICE_VIEW_SNOW_SCENE_BALLOON
    bool "Stock balloon, inverted to a night sky"

endchoice

config REBOOT_ON_FATAL_ERROR
    bool "Reboot instead of halting on a fatal error"
    default y if SHIELD_CORNE_DONGLE
    depends on REBOOT

config PROSPECTOR_STUDIO_INDICATOR
    bool "Show the ZMK Studio lock state on the Prospector display"
    default y
    depends on SHIELD_PROSPECTOR_ADAPTER && ZMK_DISPLAY && ZMK_STUDIO
```

## config/west.yml
```yaml
manifest:
  defaults:
    revision: v0.3
  remotes:
    - name: zmkfirmware
      url-base: https://github.com/zmkfirmware
    - name: kbrd-space
      url-base: https://github.com/kbrd-space
    - name: bakerbrandond
      url-base: https://github.com/bakerbrandond
    - name: zzeneg
      url-base: https://github.com/zzeneg
  projects:
    - name: zmk
      remote: zmkfirmware
      import: app/west.yml
    - name: zmk-anti-idle
      remote: kbrd-space
      revision: main
    - name: prospector-zmk-module
      remote: bakerbrandond
      revision: main # fork of carrefinho/prospector-zmk-module (ZMK v0.3): Nord theme, Zappy Birds, matrix screensaver
    - name: zmk-raw-hid
      remote: zzeneg
      revision: 6a37765dfab6197292e7a9f47305dcf87386d56a # main, 2026-08-24: Raw HID over USB + BLE (dongle clock)
  self:
    path: config
```
